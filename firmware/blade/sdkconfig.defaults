## firmware/blade/sdkconfig.defaults
```kconfig
CONFIG_MBEDTLS_HKDF_C=y
CONFIG_ESP_WIFI_ESPNOW_MAX_ENCRYPT_NUM=2
CONFIG_ESPTOOLPY_FLASHSIZE_4MB=y
CONFIG_ESPTOOLPY_FLASHSIZE="4MB"
CONFIG_PARTITION_TABLE_CUSTOM=y
CONFIG_PARTITION_TABLE_CUSTOM_FILENAME="partitions.csv"
CONFIG_PARTITION_TABLE_FILENAME="partitions.csv"
CONFIG_FREERTOS_HZ=1000
```

## firmware/computer/sdkconfig.defaults
```kconfig
CONFIG_MBEDTLS_HKDF_C=y
CONFIG_ESP_WIFI_ESPNOW_MAX_ENCRYPT_NUM=8
CONFIG_ESPTOOLPY_FLASHSIZE_4MB=y
CONFIG_ESPTOOLPY_FLASHSIZE="4MB"
CONFIG_PARTITION_TABLE_CUSTOM=y
CONFIG_PARTITION_TABLE_CUSTOM_FILENAME="partitions.csv"
CONFIG_PARTITION_TABLE_FILENAME="partitions.csv"
CONFIG_FREERTOS_HZ=1000
CONFIG_FATFS_LFN_HEAP=y
CONFIG_FATFS_MAX_LFN=64
```
